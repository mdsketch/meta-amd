## meta-amd-bsp/conf/machine/common.conf
```bitbake
# Set the preferred Linux kernel version
PREFERRED_VERSION_linux-yocto = "6.6.9"
```

## meta-amd-bsp/conf/machine/r1000.conf
```bitbake
#@TYPE: Machine
#@NAME: v1000

#@DESCRIPTION: Machine configuration for v1000 systems

require conf/machine/include/tune-zen1.inc
require conf/machine/include/wallaby.inc

# Enable AMD Cryptographic Co-processor Encryption Controller drivers
MACHINE_FEATURES:append = " ccp"
```

## meta-amd-bsp/conf/machine/siena.conf
```bitbake
#@TYPE: Machine
#@NAME: Siena

#@DESCRIPTION: Machine configuration for Siena systems

require conf/machine/include/tune-zen3.inc
require conf/machine/include/fox.inc

MACHINE_EXTRA_RRECOMMENDS += "git gdb make cmake gcc g++ vim libkcapi libtool util-linux libvirt elfutils usbredir libxext pavucontrol ceph libaio iscsi-initiator-utils usbredir spice-protocol spice pixman libxslt virt-viewer qemu kvmtool libtool libkcapi dmidecode stressapptest spidev-test"

KERNEL_MODULE_AUTOLOAD += "ntb_hw_amd ntb_pingpong ntb_tool ntb_perf nvmem_core nvme nvme-common nvmem dmatest cxl cxl_mem cxl_port cxl_core spi-amd ntb_netdev spi-amd pci-cxl cxl_acpi cxl_pmem cxl_pci spi"

MACHINE_ESSENTIAL_EXTRA_RRECOMMENDS += "kernel-modules"
#.ko file banarha hai wah config add karne e ke ebad but lsmod me show nhi ho rha hai toh ye bebelo chnages se ntb_netdev module v lsmodeme show hoga
KERNEL_MODULE_AUTOLOAD += "spi-amd"
KERNEL_MODULE_AUTOLOAD += "ntb_netdev"
#KERNEL_MODULE_AUTOLOAD += "spidev"


 
# Include common configuration
include conf/machine/common.conf
```

## meta-amd-bsp/conf/machine/v1000.conf
```bitbake
#@TYPE: Machine
#@NAME: v1000

#@DESCRIPTION: Machine configuration for Siena systems

require conf/machine/include/tune-zen3.inc
require conf/machine/include/fox.inc

MACHINE_EXTRA_RRECOMMENDS += "git gdb make cmake gcc g++ vim libkcapi libtool util-linux"
 
# Include common configuration
include conf/machine/common.conf
```
